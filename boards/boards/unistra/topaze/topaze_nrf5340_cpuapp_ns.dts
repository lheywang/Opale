/dts-v1/;
#include <nordic/nrf5340_cpuappns_qkaa.dtsi>
#include "topaze-pinctrl.dtsi"

/ {
	model = "Custom Board auto generated by nRF Connect for VS Code (CPUAPP Non-Secure)";
	compatible = "unistra,topaze-cpuapp-ns";

	chosen {
		zephyr,sram = &sram0_ns;
		zephyr,flash = &flash0;
		zephyr,code-partition = &slot0_ns_partition;
        zephyr,console = &uart0;
		zephyr,shell-uart = &uart0;
		zephyr,uart-mcumgr = &uart0;
		zephyr,bt-mon-uart = &uart0;
		zephyr,bt-c2h-uart = &uart0;
	};

    aliases {
        led0 = &led0;
    };
};

#include "topaze-cpuapp_partitioning.dtsi"
#include "topaze-shared_sram.dtsi"
