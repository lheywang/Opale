/dts-v1/;
#include <nordic/nrf5340_cpuapp_qkaa.dtsi>
#include "topaze-pinctrl.dtsi"

/ {
	model = "Custom Board auto generated by nRF Connect for VS Code (CPUAPP)";
	compatible = "unistra,topaze-cpuapp";

	chosen {
		zephyr,sram = &sram0_image;
		zephyr,flash = &flash0;
		zephyr,code-partition = &slot0_partition;
		zephyr,sram-secure-partition = &sram0_s;
		zephyr,sram-non-secure-partition = &sram0_ns;
	};
};

#include "topaze-cpuapp_partitioning.dtsi"
#include "topaze-shared_sram.dtsi"
