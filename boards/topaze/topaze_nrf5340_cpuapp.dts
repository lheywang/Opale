/* ============================================================
 * This file is the base DTS for the topaze board for the 
 * APPLICATION CPU in the secure version.
 * 
 * It only serve the purpose of including required files,
 * do not place any modifications here or they will need to be
 * multiple times.
 *
 * l.heywang
 * 18/02/2025
 *
 * ============================================================
 */

/dts-v1/;
#include <nordic/nrf5340_cpuapp_qkaa.dtsi>
#include "DTSI/topaze-pinctrl.dtsi"
#include "DTSI/topaze-aliases.dtsi"

/ {
	model = "Custom Board auto generated by nRF Connect for VS Code (CPUAPP)";
	compatible = "unistra,topaze-cpuapp";

	chosen {
		zephyr,sram = &sram0_image;
		zephyr,flash = &flash0;
		zephyr,code-partition = &slot0_partition;
		zephyr,sram-secure-partition = &sram0_s;
		zephyr,sram-non-secure-partition = &sram0_ns;
	};
};

#include "topaze-cpuapp_partitioning.dtsi"
#include "topaze-shared_sram.dtsi"
