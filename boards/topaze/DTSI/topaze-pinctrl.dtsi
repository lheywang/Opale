/* ============================================================
 * This file is the overlay DTS for topaze.
 *
 * We describe here the peripherals configuration, and so on...
 *
 * To simplify this process, I used multiples files that are
 * included, and define a single peripheral. This make the
 * reading easier !
 *
 * l.heywang
 * 18/02/2025
 *
 * ============================================================
 */

// peripheral files
// PWM
#include "topaze-pwm-servo.dtsi"
#include "topaze-pwm-rgb.dtsi"

// GPIOS
#include "topaze-leds.dtsi"

// UARTS
#include "topaze-serial-debug.dtsi"
#include "topaze-serial-gps.dtsi"
#include "topaze-serial-imu.dtsi"

// I2C
#include "topaze-I2C.dtsi"
