/* ============================================================
 * This file is the base DTS for the topaze board for the 
 * APPLICATION CPU in the non secure mode.
 * 
 * It only serve the purpose of including required files,
 * do not place any modifications here or they will need to be
 * multiple times.
 *
 * l.heywang
 * 18/02/2025
 *
 * ============================================================
 */

/dts-v1/;
#include <nordic/nrf5340_cpuappns_qkaa.dtsi>
#include "DTSI/topaze-pinctrl.dtsi"

/ {
	model = "Custom Board auto generated by nRF Connect for VS Code (CPUAPP Non-Secure)";
	compatible = "unistra,topaze-cpuapp-ns";

	chosen {
        zephyr,sram = &sram0_ns;
        zephyr,flash = &flash0;
        zephyr,code-partition = &slot0_ns_partition;
	};

};

#include "topaze-cpuapp_partitioning.dtsi"
#include "topaze-shared_sram.dtsi"
