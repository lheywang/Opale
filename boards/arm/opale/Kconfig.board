## boards/arm/opale/Kconfig.board
```kconfig
if SOC_NRF5340_CPUAPP_QKAA

config BOARD_OPALE_CPUAPP
	bool "Custom Board auto generated by nRF Connect for VS Code (CPUAPP)"

config BOARD_OPALE_CPUAPP_NS
	bool "Custom Board auto generated by nRF Connect for VS Code (CPUAPP Non-Secure)"

endif # SOC_NRF5340_CPUAPP_QKAA

config BOARD_OPALE_CPUNET
	bool "Custom Board auto generated by nRF Connect for VS Code (CPUNET)"
	depends on SOC_NRF5340_CPUNET_QKAA
```

## boards/arm/opale/opale_cpuapp_defconfig
```kconfig
CONFIG_SOC_SERIES_NRF53X=y
CONFIG_SOC_NRF5340_CPUAPP_QKAA=y
CONFIG_BOARD_OPALE_CPUAPP=y

CONFIG_ARM_MPU=y
CONFIG_HW_STACK_PROTECTION=y

CONFIG_ARM_TRUSTZONE_M=y

CONFIG_PINCTRL=y
```

## boards/boards/unistra/topaze/topaze_nrf5340_cpuapp_ns_defconfig
```kconfig
CONFIG_ARM_MPU=y
CONFIG_HW_STACK_PROTECTION=y

CONFIG_ARM_TRUSTZONE_M=y
CONFIG_TRUSTED_EXECUTION_NONSECURE=y

# Enabling some hardware
# enable GPIO
CONFIG_GPIO=y

# Enable RTT
CONFIG_USE_SEGGER_RTT=y

# enable uart driver
CONFIG_SERIAL=y

# enable console
CONFIG_CONSOLE=y
CONFIG_UART_CONSOLE=y

CONFIG_LOG=y
CONFIG_LOG_PRINTK=y
```

## boards/topaze/board.yml
```yaml
board:
  name: topaze
  vendor: unistra
  socs:
  - name: nrf5340
    variants:
    - name: ns
      cpucluster: cpuapp
```

## boards/topaze/defconfig/core/topaze_arm_defconfig
```kconfig
# ============================================================
# boards/topaze/kconfig/core/topaze_arm_defconfig 
# 
# This file is seen as a fragment of a defconfig file, and used
# to configure some things related to ARM core only.
#
# l.heywang
# 19/02/2025
#
# ============================================================

# ------------------------------------------------------------
# CORE CONFIG
# ------------------------------------------------------------
# MPU
CONFIG_ARM_MPU=y

# HSP (Hardware Stack Protection)
CONFIG_HW_STACK_PROTECTION=y

# Trustzone
CONFIG_ARM_TRUSTZONE_M=y

# Enable execution in nonsecure env.
CONFIG_TRUSTED_EXECUTION_NONSECURE=y
```

## boards/topaze/defconfig/peripherals/topaze_gpio_defconfig
```kconfig
# ============================================================
# boards/topaze/kconfig/peripherals/topaze_gpio_defconfig 
# 
# This file is seen as a fragment of a defconfig file, and used
# to configure some things related to the gpios only
#
# l.heywang
# 19/02/2025
#
# ============================================================

# ------------------------------------------------------------
# ENABLING MODULE
# ------------------------------------------------------------
CONFIG_GPIO=y
```

## boards/topaze/defconfig/peripherals/topaze_leds_defconfig
```kconfig
# ============================================================
# boards/topaze/kconfig/peripherals/topaze_leds_defconfig 
# 
# This file is seen as a fragment of a defconfig file, and used
# to configure some things related to the leds only
#
# l.heywang
# 19/02/2025
#
# ============================================================

# ------------------------------------------------------------
# ENABLING MODULE
# ------------------------------------------------------------
CONFIG_LED=y

# ------------------------------------------------------------
# MODULE CONFIG
# ------------------------------------------------------------
# Enabling PWM leds
CONFIG_LED_PWM=y
```

## boards/topaze/defconfig/tools/topaze_segger_defconfig
```kconfig
# ============================================================
# boards/topaze/kconfig/tools/topaze_segger_defconfig 
# 
# This file is seen as a fragment of a defconfig file, and used
# to configure some things related to the segger libs only 
# (debugging)
#
# l.heywang
# 19/02/2025
#
# ============================================================

# ------------------------------------------------------------
# ENABLING MODULE
# ------------------------------------------------------------
CONFIG_USE_SEGGER_RTT=y

# ------------------------------------------------------------
# MODULE CONFIG
# ------------------------------------------------------------
```

## boards/topaze/dts/bindings/pwm-buzzer.yaml
```yaml
# boards/topaze/bindings/pwm-buzzer.yml
#
# l.heywang
# 21/02/2025
#

description: PWM Buzzer parent node

compatible: "pwm-buzzer"

child-binding:
  description: PWM Buzzer chil note
  properties:
    pwms:
      required: true
      type: phandle-array
      description: |
        Three PWM outputs, in the order for : Red Green Blue.

    label:
      type: string
      description: |
        Human readable string describing the LED. It can be used by an
        application to identify this LED or to retrieve its number/index
        (i.e. child node number) on the parent device.

    period:
      type: int
      description: |
        Frequency of the PWM engine for the RGB led.
```

## boards/topaze/dts/bindings/pwm-servo.yaml
```yaml
# boards/topaze/bindings/pwm-servo.yml
#
# l.heywang
# 19/02/2025
#

description: PWM Servos parent node

compatible: "pwm-servo"

child-binding:
  description: PWM servo child node
  properties:
    pwms:
      required: true
      type: phandle-array
      description: |
        Reference to a PWM instance. (phandle + output number, from 0 to 3)

        The period field is used by the set_brightness function of the LED API.
        Its value should at least be greater that 100 nanoseconds (for a full
        brigtness granularity) and lesser than 50 milliseconds (average visual
        persistence time of the human eye). Typical values for the PWM period
        are 10 or 20 milliseconds.

    label:
      type: string
      description: |
        Human readable string describing the LED. It can be used by an
        application to identify this LED or to retrieve its number/index
        (i.e. child node number) on the parent device.

    period:
      type: int
      required: false
      description: |
        The duration of a PWM cycle (use NRF macros to get the correct format !)

    min-pulse:
      required: false
      type: int
      description: |
        Minimal value of the output pulse for the PWM servo. Generally, this is around 1 millisec.

        This value shall correspond to the minimal angle wanted.

    max-pulse:
      required: false
      type: int
      description: |
        Maximal value of the output pulse for the PWM servo. Generally, this is around 2 millisecs.

        This shall correspond to the maximum angle wanted.

    max-angle:
      required: false
      type: int
      description: |
        The maximal area that can be covered, as an unsigned integer :

        This value assume to be centered arround 0 and is calculated as MAX - MIN in absolute degrees.
        For our servo, this is :
          90 - (-90) -> 180°
```

## boards/topaze/dts/bindings/pwm-wings.yaml
```yaml
# boards/topaze/bindings/pwm-wings.yml
#
# l.heywang
# 19/02/2025
#

description: PWM Wings

compatible: "pwm-wings"

child-binding:
  description: PWM wings child node
  properties:
    pwms:
      required: true
      type: phandle-array
      description: |
        Reference to an array of PWM instance. (phandle + output number, from 0 to 3)

        Design the four servos used (up to 4 !)

    label:
      type: string
      description: |
        Human readable string describing the LED. It can be used by an
        application to identify this LED or to retrieve its number/index
        (i.e. child node number) on the parent device.

    period:
      type: int
      required: false
      description: |
        The duration of a PWM cycle (use NRF macros to get the correct format !)

    min-pulse:
      required: false
      type: int
      description: |
        Minimal value of the output pulse for the PWM servo. Generally, this is around 1 millisec.

        This value shall correspond to the minimal angle wanted.

    max-pulse:
      required: false
      type: int
      description: |
        Maximal value of the output pulse for the PWM servo. Generally, this is around 2 millisecs.

        This shall correspond to the maximum angle wanted.

    max-angle:
      required: false
      type: int
      description: |
        The maximal area that can be covered, as an unsigned integer :

        This value assume to be centered arround 0 and is calculated as MAX - MIN in absolute degrees.
        For our servo, this is :
          90 - (-90) -> 180°
```

## boards/topaze/kconfig/peripherals/topaze_pwm_defconfig
```kconfig
# ============================================================
# boards/topaze/kconfig/peripherals/topaze_pwm_defconfig 
# 
# This file is seen as a fragment of a defconfig file, and used
# to configure some things related to PWM only.
#
# l.heywang
# 19/02/2025
#
# ============================================================

# ------------------------------------------------------------
# ENABLING MODULE
# ------------------------------------------------------------
CONFIG_PWM=y

# ------------------------------------------------------------
# MODULE CONFIG
# ------------------------------------------------------------
# Enabling PWM modules one by one
CONFIG_NRFX_PWM1=y
CONFIG_NRFX_PWM2=y
CONFIG_NRFX_PWM3=y
CONFIG_NRFX_PWM4=y
```

## boards/topaze/kconfig/peripherals/topaze_serial_defconfig
```kconfig
# ============================================================
# boards/topaze/kconfig/peripherals/topaze_serial_defconfig 
# 
# This file is seen as a fragment of a defconfig file, and used
# to configure some things related to UART links
#
# l.heywang
# 19/02/2025
#
# ============================================================

# ------------------------------------------------------------
# ENABLING MODULE
# ------------------------------------------------------------
CONFIG_SERIAL=y

# ------------------------------------------------------------
# MODULE CONFIG
# ------------------------------------------------------------
```

## boards/topaze/kconfig/tools/topaze_console_defconfig
```kconfig
# ============================================================
# boards/topaze/kconfig/tools/topaze_console_defconfig 
# 
# This file is seen as a fragment of a defconfig file, and used
# to configure some things related to the console only 
# (debugging)
#
# l.heywang
# 19/02/2025
#
# ============================================================

# ------------------------------------------------------------
# ENABLING MODULE
# ------------------------------------------------------------
CONFIG_CONSOLE=y

# ------------------------------------------------------------
# MODULE CONFIG
# ------------------------------------------------------------
# Using the console over UART bus.
CONFIG_UART_CONSOLE=y
```

## boards/topaze/kconfig/tools/topaze_log_defconfig
```kconfig
# ============================================================
# boards/topaze/kconfig/tools/topaze_log_defconfig 
# 
# This file is seen as a fragment of a defconfig file, and used
# to configure some things related to the logging only
#
# l.heywang
# 19/02/2025
#
# ============================================================

# ------------------------------------------------------------
# ENABLING LOGGING
# ------------------------------------------------------------
CONFIG_LOG=y

# ------------------------------------------------------------
# MODULE CONFIG
# ------------------------------------------------------------
# Disabling UART log backend
CONFIG_LOG_BACKEND_UART=n

# Enabling the printk backend for the logs
CONFIG_LOG_PRINTK=y
```

## boards/topaze/kconfig/tools/topaze_threadanalyzer_defconfig
```kconfig
# ============================================================
# boards/topaze/kconfig/tools/topaze_pwm_defconfig 
# 
# This file is seen as a fragment of a defconfig file, and used
# to configure some things related to the thread analyzer module
# for advanced debugging
#
# l.heywang
# 19/02/2025
#
# ============================================================

# ------------------------------------------------------------
# ENABLING MODULE
# ------------------------------------------------------------
CONFIG_THREAD_ANALYZER=y 

# ------------------------------------------------------------
# MODULE CONFIG
# ------------------------------------------------------------
# Use the logger module for statistics outputs
CONFIG_THREAD_ANALYZER_USE_LOG=y

# Run the analyzer by itself
CONFIG_THREAD_ANALYZER_AUTO=y
```

## boards/topaze/topaze_nrf5340_cpuapp_ns_defconfig
```kconfig
# ============================================================
# This file is the base DTS for the topaze board.
# 
# It only serve the purpose of including required files,
# do not place any modifications here or they will need to be
# multiple times.
#
# l.heywang
# 18/02/2025
#
# ============================================================
CONFIG_ARM_MPU=y
CONFIG_HW_STACK_PROTECTION=y

CONFIG_ARM_TRUSTZONE_M=y
CONFIG_TRUSTED_EXECUTION_NONSECURE=y

CONFIG_LOG=y


# Enabling some hardware
# enable GPIO
CONFIG_GPIO=y

# Enable RTT
CONFIG_USE_SEGGER_RTT=y
CONFIG_LOG_BACKEND_UART=n

# enable uart driver
CONFIG_SERIAL=y

# enable console
CONFIG_CONSOLE=y
CONFIG_UART_CONSOLE=y

CONFIG_LOG=y
CONFIG_LOG_PRINTK=y

CONFIG_PWM=y
CONFIG_LED=y
CONFIG_LED_PWM=y
CONFIG_NRFX_PWM1=y
CONFIG_NRFX_PWM2=y
CONFIG_NRFX_PWM3=y
```
